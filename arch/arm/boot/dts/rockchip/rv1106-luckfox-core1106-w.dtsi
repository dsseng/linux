// SPDX-License-Identifier: (GPL-2.0+ OR MIT)
/*
 * Copyright (c) 2022 Rockchip Electronics Co., Ltd.
 */

#include "rv1106.dtsi"

/ {
	model = "Luckfox Core1106 Module with a wireless module";
	compatible = "luckfox,core1106-w","rockchip,rv1106";

	vdd_arm: vdd-arm {
		compatible = "regulator-fixed";
		regulator-name = "vdd_arm";
		regulator-always-on;
		regulator-boot-on;
		regulator-min-microvolt = <900000>;
		regulator-max-microvolt = <900000>;
	};
};

&cpu0_opp_table {
		/delete-node/ opp-1200000000;
		/delete-node/ opp-1296000000;
		/delete-node/ opp-1416000000;
		/delete-node/ opp-1512000000;
		/delete-node/ opp-1608000000;
};

&cpu0 {
	cpu-supply = <&vdd_arm>;
};
